// Text into an SSD1306 frame (Step 10-b): a 5x7 ASCII font and the functions that draw it.
// Rendering only, no I/O: the frame goes to the panel through /dev/edge_oled (edge_oled_ctl
// text / font), so the driver stays a transport for whole frames.
//
// Text grid: a character cell is 6x8 pixels (5 glyph columns + 1 gap, 7 glyph rows + 1 gap),
// so 128x64 holds 21 columns x 8 lines, and a line drawn at y = 8 * line sits in one page.
// Lines are clipped at the panel edges, never wrapped; characters outside ' '..'~' are drawn
// as a box. Both are counted, so a caller can tell the user what did not show as written.
#pragma once

#include <cstdint>

#include "../tools/ssd1306.h"

namespace oled_text {

constexpr int kGlyphWidth = 5;
constexpr int kGlyphHeight = 7;
constexpr int kCellWidth = 6;
constexpr int kCellHeight = 8;
constexpr int kColumns = ssd1306::kWidth / kCellWidth;   // 21
constexpr int kLines = ssd1306::kHeight / kCellHeight;   // 8

// The classic 5x7 font, ' ' (0x20) .. '~' (0x7E): one byte per column, left to right,
// bit 0 = top row (the same orientation as a GDDRAM byte). D, E and G are Step 9's.
constexpr std::uint8_t kFont[][kGlyphWidth] = {
    {0x00, 0x00, 0x00, 0x00, 0x00},  // ' '
    {0x00, 0x00, 0x5F, 0x00, 0x00},  // !
    {0x00, 0x07, 0x00, 0x07, 0x00},  // "
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    {0x10, 0x08, 0x08, 0x10, 0x08},  // ~
};
static_assert(sizeof(kFont) / sizeof(kFont[0]) == '~' - ' ' + 1, "one glyph per printable");

// Drawn for a character the font lacks, so the gap is visible and the rest stays in place.
constexpr std::uint8_t kBox[kGlyphWidth] = {0x7F, 0x41, 0x41, 0x41, 0x7F};

// nullptr outside ' '..'~' (control characters, DEL, bytes of UTF-8 sequences).
inline const std::uint8_t *glyph(char c)
{
    unsigned char u = static_cast<unsigned char>(c);
    return u >= ' ' && u <= '~' ? kFont[u - ' '] : nullptr;
}

inline void clear(ssd1306::Frame &f) { f.fill(0); }

// false when (x, y) is off the panel; the frame is left unchanged.
inline bool draw_pixel(ssd1306::Frame &f, int x, int y) { return ssd1306::set_pixel(f, x, y); }

// Top-left corner of the glyph at (x, y); pixels off the panel are dropped. false (and a box
// drawn) when c is not in the font.
inline bool draw_char(ssd1306::Frame &f, int x, int y, char c)
{
    const std::uint8_t *g = glyph(c);
    for (int col = 0; col < kGlyphWidth; ++col)
        for (int row = 0; row < kGlyphHeight; ++row)
            if ((g ? g : kBox)[col] >> row & 1)
                draw_pixel(f, x + col, y + row);
    return g != nullptr;
}

struct Result {
    int clipped = 0;       // characters not completely on the panel
    int unsupported = 0;   // characters drawn as a box (at least partly on the panel)
};

// '\n' starts the next line at the starting x, kCellHeight lower. A line longer than the
// panel is cut at the right edge.
inline Result draw_string(ssd1306::Frame &f, int x, int y, const char *s)
{
    Result r;
    for (int cx = x; *s; ++s) {
        if (*s == '\n') {
            cx = x;
            y += kCellHeight;
            continue;
        }
        if (cx < 0 || cx + kGlyphWidth > ssd1306::kWidth || y < 0 ||
            y + kGlyphHeight > ssd1306::kHeight)
            ++r.clipped;
        // A character wholly off the panel draws nothing, so it is not counted as a box.
        bool shown = cx + kGlyphWidth > 0 && cx < ssd1306::kWidth && y + kGlyphHeight > 0 &&
                     y < ssd1306::kHeight;
        if (!draw_char(f, cx, y, *s) && shown)
            ++r.unsupported;
        cx += kCellWidth;
    }
    return r;
}

// The same at a text position: line 0..7 from the top, column 0..20 from the left.
inline Result draw_text_at(ssd1306::Frame &f, int line, int column, const char *s)
{
    return draw_string(f, column * kCellWidth, line * kCellHeight, s);
}

// Every printable character once (the space is between "0123456789" and "EDGE").
constexpr const char *kFontSheet[] = {
    "ABCDEFGHIJKLM", "NOPQRSTUVWXYZ", "abcdefghijklm", "nopqrstuvwxyz",
    "0123456789 EDGE", "!\"#$%&'()*+,-./", ":;<=>?@[\\]^_`{|}~",
};

inline ssd1306::Frame font_picture()
{
    ssd1306::Frame f{};
    int line = 0;
    for (const char *s : kFontSheet)
        draw_text_at(f, line++, 0, s);
    return f;
}

}  // namespace oled_text
